## Documentation/devicetree/bindings/media/allwinner,sun60i-a733-deinterlace.yaml
```yaml
# SPDX-License-Identifier: GPL-2.0
%YAML 1.2
---
$id: http://devicetree.org/schemas/media/allwinner,sun60i-a733-deinterlace.yaml#
$schema: http://devicetree.org/meta-schemas/core.yaml#

title: Allwinner A733 DI301 Deinterlacer

maintainers:
  - Jernej Skrabec <jernej.skrabec@gmail.com>

description: |
  The DI301 is an offline memory-to-memory deinterlacer in the Allwinner
  A733 display subsystem. It reads interlaced YUV frames from memory and
  writes progressive YUV frames back to memory.

properties:
  compatible:
    const: allwinner,sun60i-a733-deinterlace

  reg:
    maxItems: 1

  interrupts:
    maxItems: 1

  clocks:
    items:
      - description: Deinterlacer module clock
      - description: Deinterlacer bus clock

  clock-names:
    items:
      - const: mod
      - const: bus

  resets:
    items:
      - description: Deinterlacer bus reset
      - description: Display subsystem reset

  reset-names:
    items:
      - const: bus
      - const: sys

  iommus:
    maxItems: 1

  power-domains:
    maxItems: 1

required:
  - compatible
  - reg
  - interrupts
  - clocks
  - clock-names
  - resets
  - reset-names
  - iommus
  - power-domains

additionalProperties: false

examples:
  - |
    #include <dt-bindings/clock/sun60i-a733-ccu.h>
    #include <dt-bindings/interrupt-controller/arm-gic.h>
    #include <dt-bindings/power/allwinner,sun60i-a733-pck-600.h>
    #include <dt-bindings/reset/sun60i-a733-ccu.h>

    deinterlace@5400000 {
        compatible = "allwinner,sun60i-a733-deinterlace";
        reg = <0x05400000 0x40000>;
        interrupts = <GIC_SPI 52 IRQ_TYPE_LEVEL_HIGH>;
        clocks = <&ccu CLK_DI>, <&ccu CLK_DI_GATE>;
        clock-names = "mod", "bus";
        resets = <&ccu RST_BUS_DI>, <&ccu RST_BUS_DE_SY>;
        reset-names = "bus", "sys";
        iommus = <&iommu 9 1>;
        power-domains = <&pck600 PD_DE_SYS>;
    };
...
```

## Documentation/devicetree/bindings/media/allwinner,sun60i-a733-g2d.yaml
```yaml
# SPDX-License-Identifier: GPL-2.0
%YAML 1.2
---
$id: http://devicetree.org/schemas/media/allwinner,sun60i-a733-g2d.yaml#
$schema: http://devicetree.org/meta-schemas/core.yaml#

title: Allwinner A733 2D Graphics Accelerator

maintainers:
  - Jernej Skrabec <jernej.skrabec@gmail.com>

description: |
  The A733 G2D contains a mixer and a copy/rotation engine. It reads
  images from memory, supports rotation, reflection, scaling and color
  conversion, and writes the processed images back to memory.

properties:
  compatible:
    const: allwinner,sun60i-a733-g2d

  reg:
    maxItems: 1

  interrupts:
    maxItems: 1

  clocks:
    items:
      - description: G2D bus gate
      - description: G2D module clock
      - description: display subsystem MBUS gate
      - description: display subsystem AHB gate

  clock-names:
    items:
      - const: bus
      - const: g2d
      - const: mbus
      - const: ahb

  resets:
    items:
      - description: G2D bus reset
      - description: display subsystem bus reset

  reset-names:
    items:
      - const: g2d
      - const: de

  iommus:
    maxItems: 1

  power-domains:
    maxItems: 1

required:
  - compatible
  - reg
  - interrupts
  - clocks
  - clock-names
  - resets
  - reset-names
  - iommus
  - power-domains

additionalProperties: false

examples:
  - |
    #include <dt-bindings/clock/sun60i-a733-ccu.h>
    #include <dt-bindings/interrupt-controller/arm-gic.h>
    #include <dt-bindings/power/allwinner,sun60i-a733-pck-600.h>
    #include <dt-bindings/reset/sun60i-a733-ccu.h>

    g2d@5440000 {
        compatible = "allwinner,sun60i-a733-g2d";
        reg = <0x05440000 0x30000>;
        interrupts = <GIC_SPI 51 IRQ_TYPE_LEVEL_HIGH>;
        clocks = <&ccu CLK_G2D_GATE>, <&ccu CLK_G2D>,
                 <&ccu CLK_MBUS_DESYS_GATE>, <&ccu CLK_DE_AHB_GATE>;
        clock-names = "bus", "g2d", "mbus", "ahb";
        resets = <&ccu RST_BUS_G2D>, <&ccu RST_BUS_DE_SY>;
        reset-names = "g2d", "de";
        iommus = <&iommu 10 1>;
        power-domains = <&pck600 PD_DE_SYS>;
    };
...
```

## Documentation/devicetree/bindings/phy/allwinner,sun60i-a733-display-combo-phy.yaml
```yaml
# SPDX-License-Identifier: GPL-2.0
%YAML 1.2
---
$id: http://devicetree.org/schemas/phy/allwinner,sun60i-a733-display-combo-phy.yaml#
$schema: http://devicetree.org/meta-schemas/core.yaml#

title: Allwinner A733 Display Combo-PHY

maintainers:
  - Chen-Yu Tsai <wens@csie.org>

description:
  The A733 display Combo-PHY contains the analog transmitter and dedicated
  display PLL shared by an LVDS output and a MIPI DSI host. Each instance
  has its own register window, bus clock and reset line.

properties:
  compatible:
    const: allwinner,sun60i-a733-display-combo-phy

  reg:
    maxItems: 1

  clocks:
    items:
      - description: Combo-PHY bus clock
      - description: 24 MHz reference clock for the display PLL

  clock-names:
    items:
      - const: bus
      - const: ref

  resets:
    maxItems: 1

  "#phy-cells":
    const: 0

required:
  - compatible
  - reg
  - clocks
  - clock-names
  - resets
  - "#phy-cells"

additionalProperties: false

examples:
  - |
    #include <dt-bindings/clock/sun60i-a733-ccu.h>
    #include <dt-bindings/reset/sun60i-a733-ccu.h>

    phy@5507000 {
        compatible = "allwinner,sun60i-a733-display-combo-phy";
        reg = <0x05507000 0x200>;
        clocks = <&ccu CLK_BUS_DSI0>, <&dcxo24M>;
        clock-names = "bus", "ref";
        resets = <&ccu RST_BUS_DSI0>;
        #phy-cells = <0>;
    };
...
```

## drivers/media/platform/sunxi/sun60i-di/Kconfig
```kconfig
# SPDX-License-Identifier: GPL-2.0-only
# Copyright(c) 2020 - 2023 Allwinner Technology Co.,Ltd. All rights reserved.

config VIDEO_SUN60I_DI
	tristate "Allwinner A733 deinterlace driver"
	depends on V4L_MEM2MEM_DRIVERS
	depends on ARCH_SUNXI || COMPILE_TEST
	depends on VIDEO_DEV
	depends on COMMON_CLK && RESET_CONTROLLER && OF
	depends on PM
	select VIDEOBUF2_DMA_CONTIG
	select V4L2_MEM2MEM_DEV
	help
	  Support the DI301 memory-to-memory deinterlacer found in the
	  Allwinner A733 SoC. The driver exposes a V4L2 mem2mem device and
	  currently supports bob deinterlacing of NV12 and NV21 video.
	  Each interlaced output buffer produces two progressive capture
	  buffers, one for each input field.
```

## drivers/media/platform/sunxi/sun60i-g2d/Kconfig
```kconfig
# SPDX-License-Identifier: GPL-2.0-only
# Copyright(c) 2020 - 2023 Allwinner Technology Co.,Ltd. All rights reserved.

config VIDEO_SUN60I_G2D
	tristate "Allwinner A733 G2D driver"
	depends on V4L_MEM2MEM_DRIVERS
	depends on ARCH_SUNXI || COMPILE_TEST
	depends on VIDEO_DEV
	depends on COMMON_CLK && RESET_CONTROLLER && OF
	depends on PM
	select VIDEOBUF2_DMA_CONTIG
	select V4L2_MEM2MEM_DEV
	help
	  Support the G2D accelerator found in the Allwinner A733 SoC.
	  The driver exposes the copy/rotate and mixer engines through the
	  V4L2 memory-to-memory API. It supports rotation, reflection, scaling
	  and RGB/YUV format conversion. Scaling and format conversion cannot
	  be combined with rotation or reflection in a single operation.

	  To compile this driver as a module, choose M here.
```
